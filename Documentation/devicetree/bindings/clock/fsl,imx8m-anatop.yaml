## Documentation/devicetree/bindings/clock/fsl,imx8m-anatop.yaml
```yaml
# SPDX-License-Identifier: (GPL-2.0-only OR BSD-2-Clause)
%YAML 1.2
---
$id: http://devicetree.org/schemas/clock/fsl,imx8m-anatop.yaml#
$schema: http://devicetree.org/meta-schemas/core.yaml#

title: NXP i.MX8M Family Anatop Module

maintainers:
  - Peng Fan <peng.fan@nxp.com>

description: |
  NXP i.MX8M Family anatop PLL module which generates PLL to CCM root.

properties:
  compatible:
    oneOf:
      - enum:
          - fsl,imx8mm-anatop
          - fsl,imx8mq-anatop
      - items:
          - enum:
              - fsl,imx8mn-anatop
              - fsl,imx8mp-anatop
          - const: fsl,imx8mm-anatop

  reg:
    maxItems: 1

  interrupts:
    maxItems: 1

  clocks:
    minItems: 2
    maxItems: 3

  clock-names:
    minItems: 2
    maxItems: 3

  '#clock-cells':
    const: 1

required:
  - compatible
  - reg
  - clocks
  - clock-names
  - '#clock-cells'

allOf:
  - if:
      properties:
        compatible:
          contains:
            const: fsl,imx8mq-anatop
    then:
      properties:
        clocks:
          items:
            - description: 32k osc
            - description: 25m osc
            - description: 27m osc
        clock-names:
          items:
            - const: ckil
            - const: osc_25m
            - const: osc_27m
    else:
      properties:
        clocks:
          items:
            - description: 32k osc
            - description: 24m osc

        clock-names:
          items:
            - const: osc_32k
            - const: osc_24m

additionalProperties: false

examples:
  - |
    clock-controller@30360000 {
        compatible = "fsl,imx8mn-anatop", "fsl,imx8mm-anatop";
        reg = <0x30360000 0x10000>;
        #clock-cells = <1>;
        clocks = <&osc_32k>, <&osc_24m>;
        clock-names = "osc_32k", "osc_24m";
    };

  - |
    clock-controller@30360000 {
        compatible = "fsl,imx8mq-anatop";
        reg = <0x30360000 0x10000>;
        #clock-cells = <1>;
        clocks = <&ckil>, <&osc_25m>, <&osc_27m>;
        clock-names = "ckil", "osc_25m", "osc_27m";
    };

...
```

## Documentation/devicetree/bindings/clock/marvell,cp110-clock.yaml
```yaml
# SPDX-License-Identifier: (GPL-2.0-only OR BSD-2-Clause)
%YAML 1.2
---
$id: http://devicetree.org/schemas/clock/marvell,cp110-clock.yaml#
$schema: http://devicetree.org/meta-schemas/core.yaml#

title: Marvell Armada CP110 System Controller Clocks

maintainers:
  - Gregory Clement <gregory.clement@bootlin.com>
  - Miquel Raynal <miquel.raynal@bootlin.com>

description: >
  The CP110 is one of the two core HW blocks of the Marvell Armada 7K/8K/931x
  SoCs. It contains system controllers, which provide several registers giving
  access to numerous features: clocks, pin-muxing and many other SoC
  configuration items.

properties:
  compatible:
    const: marvell,cp110-clock

  "#clock-cells":
    const: 2

required:
  - compatible
  - "#clock-cells"

additionalProperties: false
```

## Documentation/devicetree/bindings/soc/fsl/cpm_qe/qe/par_io.txt
```
* Parallel I/O Ports

This node configures Parallel I/O ports for CPUs with QE support.
The node should reside in the "soc" node of the tree.  For each
device that using parallel I/O ports, a child node should be created.
See the definition of the Pin configuration nodes below for more
information.

Required properties:
- device_type : should be "par_io".
- reg : offset to the register set and its length.
- num-ports : number of Parallel I/O ports

Example:
par_io@1400 {
	reg = <1400 100>;
	#address-cells = <1>;
	#size-cells = <0>;
	device_type = "par_io";
	num-ports = <7>;
	ucc_pin@1 {
		......
	};

Note that "par_io" nodes are obsolete, and should not be used for
the new device trees. Instead, each Par I/O bank should be represented
via its own gpio-controller node:

Required properties:
- #gpio-cells : should be "2".
- compatible : should be "fsl,<chip>-qe-pario-bank",
  "fsl,mpc8323-qe-pario-bank".
- reg : offset to the register set and its length.
- gpio-controller : node to identify gpio controllers.
Optional properties:
- fsl,qe-gpio-irq-mask : For banks having interrupt capability this item tells
  which ports have an associated interrupt (ports are listed in the same order
  as in QE ports registers)
- interrupts : This property provides the list of interrupt for each GPIO having
  one as described by the fsl,cpm1-gpio-irq-mask property. There should be as
  many interrupts as number of ones in the mask property. The first interrupt in
  the list corresponds to the most significant bit of the mask.
- interrupt-parent : Parent for the above interrupt property.

Example:
	qe_pio_a: gpio-controller@1400 {
		#gpio-cells = <2>;
		compatible = "fsl,mpc8360-qe-pario-bank",
		"fsl,mpc8323-qe-pario-bank";
		reg = <0x1400 0x18>;
		gpio-controller;
	  };

	qe_pio_b: gpio-controller@1418 {
		#gpio-cells = <2>;
		compatible = "fsl,mpc8323-qe-pario-bank";
		reg = <0x1418 0x18>;
		interrupts = <4 5 6 7>;
		fsl,qe-gpio-irq-mask = <0x01400050>;
		interrupt-parent = <&qepic>;
		gpio-controller;
	  };

	qe_pio_e: gpio-controller@1460 {
		#gpio-cells = <2>;
		compatible = "fsl,mpc8360-qe-pario-bank",
			     "fsl,mpc8323-qe-pario-bank";
		reg = <0x1460 0x18>;
		gpio-controller;
	  };
```

## kernel/liveupdate/Kconfig
```kconfig
# SPDX-License-Identifier: GPL-2.0-only

menu "Live Update"

config KEXEC_HANDOVER
	bool "kexec handover"
	depends on ARCH_SUPPORTS_KEXEC_HANDOVER && ARCH_SUPPORTS_KEXEC_FILE
	depends on !DEFERRED_STRUCT_PAGE_INIT
	select MEMBLOCK_KHO_SCRATCH
	select KEXEC_FILE
	select DEBUG_FS
	select LIBFDT
	select CMA
	help
	  Allow kexec to hand over state across kernels by generating and
	  passing additional metadata to the target kernel. This is useful
	  to keep data or state alive across the kexec. For this to work,
	  both source and target kernels need to have this option enabled.

config KEXEC_HANDOVER_DEBUGFS
	bool "kexec handover debugfs interface"
	depends on KEXEC_HANDOVER
	depends on DEBUG_FS
	help
	  Allow to control kexec handover device tree via debugfs
	  interface, i.e. finalize the state or aborting the finalization.
	  Also, enables inspecting the KHO fdt trees with the debugfs binary
	  blobs.

endmenu
```

## lib/raid/Kconfig
```kconfig
config XOR_BLOCKS
	tristate

# selected by architectures that provide an optimized XOR implementation
config XOR_BLOCKS_ARCH
	bool
```
